## Kconfig
```kconfig
#FIXME for now it will be nice to have only Bridge or Studio. Fix later.

menuconfig ZMK_BRIDGE
    bool "Enable ZMK Bridge module support for a board"
    select SERIAL
    select NANOPB
    imply NANOPB_NO_ERRMSG
    imply NANOPB_WITHOUT_64BIT
    imply NANOPB_NO_ENCODE_SIZE_CHECK
    select RING_BUFFER
    select SETTINGS

if ZMK_BRIDGE 

module = ZMK_BRIDGE
module-str = zmk_bridge
source "subsys/logging/Kconfig.template.log_config"

config ZMK_BRIDGE_RX_BUF_SIZE
    int
    default 32

config ZMK_BRIDGE_TX_BUF_SIZE
    int
    default 64

config ZMK_BRIDGE_TRANSPORT_UART_RX_STACK_SIZE
    int "RX Stack Size"
    default 512

config ZMK_BRIDGE_THREAD_STACK_SIZE
    int "Bridge Thread Stack Size"
    default 4096

config ZMK_BRIDGE_DEVICE_ID
    int "Device ID"
    default 1

endif
```

## west.yml
```yaml
manifest:
  remotes:
    - name: nanopb
      url-base: https://github.com/nanopb
  project-imports:
    allow-override: true
  projects:
    - name: nanopb
      revision: master
      path: modules_bridge/lib/nanopb
      
      import: west.yml
```
