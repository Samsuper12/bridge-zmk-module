/*
 * Copyright (c) 2025 The ZMK Contributors
 *
 * SPDX-License-Identifier: MIT
 */

/ {
    chosen {
        zmk,bridge-uart = &snippet_bridge_usb_uart;
    };
};

&zephyr_udc0 {
    snippet_bridge_usb_uart: snippet_bridge_usb_uart {
        compatible = "zephyr,cdc-acm-uart";
    };
};
